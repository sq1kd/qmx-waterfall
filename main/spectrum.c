/*
 * spectrum.c — IQ spectrum FFT display with waterfall
 *
 * Pipeline (runs on core 1, pinned):
 *   UAC RX_DONE (core 0) ──TaskNotify──► spectrum_task
 *     → uac_host_device_read()
 *     → decode PCM-24 / PCM-16 stereo → complex float [I, Q]
 *     → accumulate FFT_SIZE samples
 *     → Hann window
 *     → dsps_fft2r_fc32  (in-place complex FFT)
 *     → magnitudes, fftshift
 *     → store dB row in waterfall ring buffer
 *     → draw spectrum line plot (top 25 px)
 *     → draw waterfall from ring buffer (bottom 51 px)
 *     → draw filter overlay and IF marker
 *     → lv_obj_invalidate(canvas)
 *
 * Logical display after 90° CW rotation: 284 wide × 76 tall.
 * Layout: spectrum line plot (top 25 px), waterfall (bottom 51 px).
 * Newest waterfall row at top of waterfall area, scrolling down.
 *
 * Two view modes:
 *   0 = full spectrum (all FFT bins, DC in centre after fftshift)
 *   1 = positive-only (upper half of fftshift output, 0..+Fs/2)
 */

#include "spectrum.h"

#include <string.h>
#include <math.h>
#include <stdlib.h>
#include "freertos/FreeRTOS.h"
#include "freertos/task.h"
#include "esp_log.h"
#include "esp_err.h"
#include "esp_heap_caps.h"
#include "esp_lvgl_port.h"
#include "esp_dsp.h"

/* Logical display dimensions after rotation */
#define DISP_W 284 /* landscape width  (was physical height) */
#define DISP_H 76  /* landscape height (was physical width)  */

/* Layout: spectrum line plot on top, waterfall below */
#define SPEC_H 25  /* spectrum strip height in pixels */
#define WF_H   51  /* waterfall height in pixels      */
#define WF_Y0  SPEC_H /* first waterfall row in canvas */

/* Read buffer: enough for ~20 ms of 24-bit stereo @ 48 kHz
 * 48000 * 0.020 * 2 ch * 3 bytes = 5760 bytes — round up to power of 2 */
#define READ_BUF_BYTES 6144

static const char *TAG = "spectrum";

/* -------------------------------------------------------------------------- */
/* Turbo colormap — 256-entry RGB565 LUT                                       */
/* Generated from Google Research turbo_srgb_floats definition.               */
/* Index 0 = darkest (floor dB), index 255 = brightest (ceil dB).            */
/* -------------------------------------------------------------------------- */

static const uint16_t turbo_lut[256] = {
    /* Generated by mapping turbo_srgb_floats[i] → RGB565 for i=0..255 */
    /* Each value is ((R & 0xF8) << 8) | ((G & 0xFC) << 3) | (B >> 3) */
    0x1811, 0x2011, 0x2011, 0x2012, 0x2012, 0x2812, 0x2812, 0x2813,
    0x2813, 0x2813, 0x2814, 0x3014, 0x3014, 0x3015, 0x3015, 0x3016,
    0x3016, 0x3016, 0x3017, 0x3017, 0x3818, 0x3018, 0x3819, 0x3819,
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    0xF9FF, 0xF9DF, 0xF1BF, 0xF1BF, 0xF19F, 0xE99F, 0xE97F, 0xE17F,
};

/* -------------------------------------------------------------------------- */
/* Module state                                                                */
/* -------------------------------------------------------------------------- */

static struct
{
    lv_obj_t *canvas;
    uint16_t *canvas_buf; /* RGB565, DISP_W × DISP_H        */
    spectrum_cfg_t cfg;
    uac_host_device_handle_t uac_handle;
    TaskHandle_t task_handle;

    /* Audio stream parameters discovered from USB descriptor */
    uint8_t channels;
    uint8_t bit_resolution;
    uint8_t bytes_per_sample;
    uint32_t sample_freq;

    /* DSP buffers */
    float *fft_buf;    /* size: fft_size * 2 (interleaved Re/Im) */
    float *window;     /* Hann window, fft_size floats            */

    /* Accumulation state */
    uint32_t accum_idx; /* samples accumulated so far              */
    uint8_t read_raw[READ_BUF_BYTES];

    bool dsp_initialized; /* true after dsps_fft2r_init_fc32 succeeds */

    /* IF marker */
    int marker_px; /* pixel column for the IF line; -1 = disabled  */

    /* CAT-driven spectrum filter overlay */
    uint8_t mode_code;
    uint32_t filter_hz;

    float level_offset_db;

    /* Waterfall state */
    float *wf_db;           /* ring buffer: WF_H rows × DISP_W floats  */
    uint32_t wf_write_idx;  /* next row to write (0..WF_H-1)           */
    float wf_db_floor;      /* dB value mapping to LUT index 0         */
    float wf_db_ceil;       /* dB value mapping to LUT index 255       */
    uint8_t view_mode;      /* 0=full spectrum, 1=positive-only         */

} s;

/* -------------------------------------------------------------------------- */
/* Colour helpers                                                              */
/* -------------------------------------------------------------------------- */

/* Pack R5G6B5 for the ST7789 */
static inline uint16_t rgb565(uint8_t r, uint8_t g, uint8_t b)
{
    return ((uint16_t)(r & 0xF8) << 8) |
           ((uint16_t)(g & 0xFC) << 3) |
           ((uint16_t)(b >> 3));
}

#define SPEC_BG rgb565(0x00, 0x00, 0x08) /* near-black navy background */
#define SPEC_FG rgb565(0x00, 0xFF, 0x00) /* pure green trace           */
#define SPEC_FILTER_FILL rgb565(0x52, 0x52, 0x52)
#define SPEC_FILTER_EDGE rgb565(0x9A, 0x9A, 0x9A)

/* Map a dB value to a turbo LUT index (0..255), clamped. */
static inline uint8_t db_to_color_idx(float db)
{
    float range = s.wf_db_ceil - s.wf_db_floor;
    if (range < 1.0f) range = 1.0f;
    float norm = (db - s.wf_db_floor) / range;
    if (norm < 0.0f) norm = 0.0f;
    if (norm > 1.0f) norm = 1.0f;
    return (uint8_t)(norm * 255.0f + 0.5f);
}

/* -------------------------------------------------------------------------- */
/* Helpers                                                                     */
/* -------------------------------------------------------------------------- */

/*
 * Bin/pixel mapping.  In full-spectrum mode the full fft_size bins span
 * DISP_W pixels.  In positive-only mode only the upper half of the
 * fftshift output (bins fft_size/2 .. fft_size-1) is used, so the
 * effective bin count is fft_size/2.
 */
static int effective_bins(void)
{
    return s.view_mode == 1 ? (int)(s.cfg.fft_size / 2) : (int)s.cfg.fft_size;
}

static bool marker_to_bin(float *bin_out)
{
    if (s.marker_px < 0)
    {
        return false;
    }
    *bin_out = ((float)s.marker_px * (float)(effective_bins() - 1)) / (float)(DISP_W - 1);
    return true;
}

static int bin_to_px(float bin)
{
    int nbins = effective_bins();
    int px = (int)(bin * (float)(DISP_W - 1) / (float)(nbins - 1) + 0.5f);
    if (px < 0)
        px = 0;
    if (px >= DISP_W)
        px = DISP_W - 1;
    return px;
}

static void fftshift_mag(float *mag, int len)
{
    int half = len / 2;
    for (int i = 0; i < half; i++)
    {
        float t = mag[i];
        mag[i] = mag[i + half];
        mag[i + half] = t;
    }
}

#ifndef M_PI
#define M_PI 3.14159265358979323846f
#endif

static void build_hann_window(float *win, int len)
{
    for (int i = 0; i < len; i++)
    {
        win[i] = 0.5f * (1.0f - cosf(2.0f * (float)M_PI * (float)i / (float)(len - 1)));
    }
}

/* -------------------------------------------------------------------------- */
/* Drawing functions                                                           */
/* -------------------------------------------------------------------------- */

/*
 * Draw spectrum line plot into the top SPEC_H rows of the canvas.
 * mag points to either the full fftshift'd array or the positive-only
 * sub-array; mag_len is the number of usable bins.
 */
static void draw_spectrum_strip(uint16_t *canvas_buf,
                                const float *mag, int mag_len)
{
    /* Clear spectrum rows to near-black background */
    for (int i = 0; i < SPEC_H * DISP_W; i++)
        canvas_buf[i] = SPEC_BG;

    const float dyn_db = s.wf_db_ceil - s.wf_db_floor;
    const float bot_db = s.wf_db_floor;

    int prev_y = -1;
    for (int px = 0; px < DISP_W; px++)
    {
        /* Linear interpolation: map pixel to fractional bin index */
        float fbin = (float)px * (float)(mag_len - 1) / (float)(DISP_W - 1);
        int bin = (int)fbin;
        if (bin >= mag_len - 1) bin = mag_len - 2;
        if (bin < 0) bin = 0;
        float frac = fbin - (float)bin;

        float m = mag[bin] * (1.0f - frac) + mag[bin + 1] * frac;
        float db = 10.0f * log10f(m + 1e-12f) + s.level_offset_db;
        float norm = (db - bot_db) / dyn_db;
        if (norm < 0.0f)
            norm = 0.0f;
        if (norm > 1.0f)
            norm = 1.0f;

        /* y=0 is top; high signal = low y_top (tall bar) */
        int y_top = (SPEC_H - 1) - (int)(norm * (SPEC_H - 1));

        if (prev_y != -1) {
            int y0 = prev_y;
            int y1 = y_top;
            if (y0 > y1) {
                int tmp = y0; y0 = y1; y1 = tmp;
            }
            for (int y = y0; y <= y1; y++) {
                canvas_buf[y * DISP_W + px] = SPEC_FG;
            }
        } else {
            canvas_buf[y_top * DISP_W + px] = SPEC_FG;
        }
        prev_y = y_top;
    }
}

/*
 * Draw the waterfall into rows WF_Y0 .. WF_Y0+WF_H-1 of the canvas.
 * Reads from the ring buffer of dB values, newest row at top.
 */
static void draw_waterfall(uint16_t *canvas_buf)
{
    if (!s.wf_db) return;

    for (int row = 0; row < WF_H; row++)
    {
        /* row 0 = newest (wf_write_idx - 1), row WF_H-1 = oldest */
        int ring_idx = (int)s.wf_write_idx - 1 - row;
        if (ring_idx < 0) ring_idx += WF_H;

        const float *db_row = &s.wf_db[ring_idx * DISP_W];
        uint16_t *px_row = &canvas_buf[(WF_Y0 + row) * DISP_W];

        for (int x = 0; x < DISP_W; x++)
        {
            px_row[x] = turbo_lut[db_to_color_idx(db_row[x])];
        }
    }
}

static void draw_filter_overlay(uint16_t *canvas_buf)
{
    if (s.filter_hz == 0 || s.sample_freq == 0) return;

    float center_bin = 0.0f;
    if (!marker_to_bin(&center_bin)) return;

    int nbins = effective_bins();
    float bw_bins = (float)s.filter_hz * (float)nbins / (float)s.sample_freq;
    if (s.view_mode == 0) {
        /* Full spectrum: bw_bins is relative to fft_size bins mapped to DISP_W */
        bw_bins = (float)s.filter_hz * (float)s.cfg.fft_size / (float)s.sample_freq;
    }

    float left_bin = center_bin - bw_bins * 0.5f;
    float right_bin = center_bin + bw_bins * 0.5f;

    switch (s.mode_code) {
        case 1: /* LSB */ left_bin = center_bin - bw_bins; right_bin = center_bin; break;
        case 2: /* USB */ left_bin = center_bin; right_bin = center_bin + bw_bins; break;
        default: break;
    }

    int left_px = bin_to_px(left_bin);
    int right_px = bin_to_px(right_bin);
    if (right_px < left_px) {
        int t = left_px; left_px = right_px; right_px = t;
    }

    /* Draw overlay on spectrum strip only (top SPEC_H rows) */
    for (int y = 0; y < SPEC_H; y++) {
        uint16_t *row = &canvas_buf[y * DISP_W];
        for (int x = left_px; x <= right_px; x++) {
            uint16_t cur = row[x];
            row[x] = ((cur >> 1) & 0x7BEF) + ((SPEC_FILTER_FILL >> 1) & 0x7BEF);
        }
        if (left_px >= 0 && left_px < DISP_W) row[left_px] = SPEC_FILTER_EDGE;
        if (right_px >= 0 && right_px < DISP_W) row[right_px] = SPEC_FILTER_EDGE;
    }
}

/*
 * Store a row of dB values into the waterfall ring buffer.
 * mag points to the (possibly positive-only) magnitude array; mag_len bins.
 * Each pixel is mapped from bins via linear interpolation, converted to dB.
 */
static void store_wf_row(const float *mag, int mag_len)
{
    if (!s.wf_db) return;

    float *dst = &s.wf_db[s.wf_write_idx * DISP_W];

    for (int px = 0; px < DISP_W; px++)
    {
        float fbin = (float)px * (float)(mag_len - 1) / (float)(DISP_W - 1);
        int bin = (int)fbin;
        if (bin >= mag_len - 1) bin = mag_len - 2;
        if (bin < 0) bin = 0;
        float frac = fbin - (float)bin;

        float m = mag[bin] * (1.0f - frac) + mag[bin + 1] * frac;
        dst[px] = 10.0f * log10f(m + 1e-12f) + s.level_offset_db;
    }

    s.wf_write_idx = (s.wf_write_idx + 1) % WF_H;
}


/* -------------------------------------------------------------------------- */
/* spectrum task (core 1)                                                     */
/* -------------------------------------------------------------------------- */

static void spectrum_task(void *arg)
{
    ESP_LOGI(TAG, "spectrum task started (fft=%u, %.1f lines/s, view=%u)",
             s.cfg.fft_size, s.cfg.lines_per_sec, s.view_mode);

    const uint32_t fft_size = s.cfg.fft_size;
    const uint32_t ms_per_line = (uint32_t)(1000.0f / s.cfg.lines_per_sec);
    TickType_t last_push = 0;
    while (true)
    {
        /* Wait for RX_DONE notification from core 0.
         * pdTRUE clears the notification count, but we drain the ring
         * buffer fully below so stacked notifications are harmless. */
        ulTaskNotifyTake(pdTRUE, portMAX_DELAY);

        if (s.uac_handle == NULL)
        {
            continue;
        }

        /* ---- Drain the UAC ring buffer completely ----
         * The USB host pushes data at 48 kHz × 6 B/frame = 288 KB/s.
         * We must consume it all to prevent ring buffer overflow and
         * the resulting byte-stream discontinuities.  Display rendering
         * is rate-limited separately below. */
        const uint8_t bytes_per_sample = s.bytes_per_sample;
        const uint8_t frame_bytes = bytes_per_sample * s.channels;

        while (true)
        {
            uint32_t bytes_read = 0;
            esp_err_t err = uac_host_device_read(s.uac_handle,
                                                 s.read_raw,
                                                 sizeof(s.read_raw),
                                                 &bytes_read,
                                                 0 /* non-blocking */);
            if (err != ESP_OK || bytes_read == 0)
            {
                break; /* ring buffer drained */
            }

            const uint32_t frames = bytes_read / frame_bytes;

            for (uint32_t f = 0; f < frames; f++)
            {
                const uint8_t *p = s.read_raw + f * frame_bytes;

                float i_samp, q_samp;

                if (s.bit_resolution == 24)
                {
                    bool use_24in4 = (bytes_per_sample >= 4);
                    if (use_24in4)
                    {
                        if (bytes_per_sample < 4 || frame_bytes < 8)
                        {
                            continue;
                        }
                        /* 24-bit audio in 4-byte container (right-justified / LSB-aligned):
                         * bytes [0]=LSB [1]=MID [2]=MSB [3]=pad(0).
                         * Read lower 3 bytes and sign-extend from bit 23. */
                        int32_t iv = (int32_t)(p[0] | ((uint32_t)p[1] << 8) | ((uint32_t)p[2] << 16));
                        if (iv & 0x800000) iv |= (int32_t)0xFF000000;
                        i_samp = (float)iv / 8388608.0f;

                        const uint8_t *q = p + bytes_per_sample;
                        int32_t qv = (int32_t)(q[0] | ((uint32_t)q[1] << 8) | ((uint32_t)q[2] << 16));
                        if (qv & 0x800000) qv |= (int32_t)0xFF000000;
                        q_samp = (float)qv / 8388608.0f;
                    }
                    else
                    {
                        int32_t iv = (int32_t)(p[0] | ((uint32_t)p[1] << 8) | ((uint32_t)p[2] << 16));
                        if (iv & 0x800000)
                            iv |= (int32_t)0xFF000000;
                        i_samp = (float)iv / 8388608.0f;

                        const uint8_t *q = p + bytes_per_sample;
                        int32_t qv = (int32_t)(q[0] | ((uint32_t)q[1] << 8) | ((uint32_t)q[2] << 16));
                        if (qv & 0x800000)
                            qv |= (int32_t)0xFF000000;
                        q_samp = (float)qv / 8388608.0f;
                    }
                }
                else
                {
                    /* 16-bit signed little-endian fallback */
                    int16_t iv = (int16_t)(p[0] | ((uint16_t)p[1] << 8));
                    i_samp = (float)iv / 32768.0f;
                    const uint8_t *q = p + bytes_per_sample;
                    int16_t qv = (int16_t)(q[0] | ((uint16_t)q[1] << 8));
                    q_samp = (float)qv / 32768.0f;
                }

                /* fft_buf layout: [Re0, Im0, Re1, Im1, ...] */
                uint32_t idx = s.accum_idx;
                s.fft_buf[idx * 2] = i_samp * s.window[idx];
                s.fft_buf[idx * 2 + 1] = q_samp * s.window[idx];
                s.accum_idx++;

                if (s.accum_idx >= fft_size)
                {
                    s.accum_idx = 0;

                    /* Run FFT — use ANSI C path to bypass AES3 SIMD */
                    dsps_fft2r_fc32_ansi(s.fft_buf, (int)fft_size);
                    dsps_bit_rev_fc32(s.fft_buf, (int)fft_size);

                    /* Compute magnitude² for each bin (unnormalized, matching Python
                     * convention: 10*log10(|X|²) so dB values are directly comparable
                     * with the pc/iq_live_view.py reference viewer). */
                    float mag[fft_size]; /* stack-allocated; fft_size ≤ 1024 */
                    for (uint32_t k = 0; k < fft_size; k++)
                    {
                        float re = s.fft_buf[k * 2];
                        float im = s.fft_buf[k * 2 + 1];
                        float pwr = re * re + im * im;
                        mag[k] = pwr;  /* store power; converted to dB later */
                    }

                    /* Shift so DC is in the centre (negative freq left) */
                    fftshift_mag(mag, (int)fft_size);

                    /* Select sub-array for positive-only mode */
                    const float *render_mag = mag;
                    int render_bins = (int)fft_size;
                    if (s.view_mode == 1)
                    {
                        render_mag = &mag[fft_size / 2];
                        render_bins = (int)(fft_size / 2);
                    }

                    /* Always store waterfall row (cheap, keeps history current) */
                    store_wf_row(render_mag, render_bins);

                    /* Rate-limited display push: render + push only when
                     * enough time has elapsed since the last frame. */
                    TickType_t now = xTaskGetTickCount();
                    TickType_t elapsed_ms = (now - last_push) * portTICK_PERIOD_MS;
                    if (last_push == 0 || elapsed_ms >= ms_per_line)
                    {
                        last_push = now;

                        /* Spectrum strip (top SPEC_H rows) */
                        draw_spectrum_strip(s.canvas_buf, render_mag, render_bins);

                        /* Waterfall (bottom WF_H rows) — redrawn from ring buffer */
                        draw_waterfall(s.canvas_buf);

                        draw_filter_overlay(s.canvas_buf);

                        /* IF marker: red vertical line through spectrum strip */
                        if (s.marker_px >= 0)
                            for (int y = 0; y < SPEC_H; y++)
                                s.canvas_buf[y * DISP_W + s.marker_px] = rgb565(0xFF, 0x00, 0x00);

                        if (lvgl_port_lock(0))
                        {
                            lv_obj_invalidate(s.canvas);
                            lvgl_port_unlock();
                        }
                    }

                } /* end FFT frame complete */
            } /* end per-frame loop */
        } /* end ring buffer drain loop */
    } /* end main task loop */
}

/* -------------------------------------------------------------------------- */
/* Public API                                                                  */
/* -------------------------------------------------------------------------- */

void spectrum_default_cfg(spectrum_cfg_t *cfg)
{
    cfg->fft_size = 512;
    cfg->lines_per_sec = 25.3f; /* 25 fps */
    cfg->if_freq_hz = 12000;    /* QMX IF offset */
}


void spectrum_set_filter_params(uint8_t mode_code, uint32_t filter_hz)
{
    if (mode_code > 9)
    {
        mode_code = 0;
    }
    s.mode_code = mode_code;
    s.filter_hz = filter_hz;
}

void spectrum_set_level_offset_db(float offset_db)
{
    if (offset_db < -80.0f)
        offset_db = -80.0f;
    if (offset_db > 80.0f)
        offset_db = 80.0f;
    s.level_offset_db = offset_db;
}

void spectrum_set_view_mode(uint8_t mode)
{
    if (mode > 1)
        mode = 0;
    s.view_mode = mode;

    /* Recompute IF marker pixel for the new bin mapping */
    if (s.cfg.if_freq_hz > 0 && s.sample_freq > 0)
    {
        int nbins = (mode == 1) ? (int)(s.cfg.fft_size / 2) : (int)s.cfg.fft_size;
        float if_bin;
        if (mode == 1)
        {
            /* positive-only: IF maps directly as fraction of Fs/2 */
            if_bin = (float)s.cfg.if_freq_hz * (float)(s.cfg.fft_size) / (float)s.sample_freq;
            /* Clamp to the positive-only bin range */
            if (if_bin >= (float)nbins) if_bin = (float)(nbins - 1);
        }
        else
        {
            /* full spectrum: IF is offset from DC at centre */
            float dc_bin = (float)(s.cfg.fft_size / 2);
            if_bin = dc_bin + (float)s.cfg.if_freq_hz * (float)(s.cfg.fft_size) / (float)s.sample_freq;
        }
        s.marker_px = (int)(if_bin * (float)(DISP_W - 1) / (float)(nbins - 1) + 0.5f);
        if (s.marker_px < 0) s.marker_px = 0;
        if (s.marker_px >= DISP_W) s.marker_px = DISP_W - 1;
    }

    ESP_LOGI(TAG, "[sp] view_mode=%u marker_px=%d", mode, s.marker_px);
}

void spectrum_set_wf_range(float floor_db, float ceil_db)
{
    if (floor_db >= ceil_db)
    {
        ESP_LOGW(TAG, "[sp] invalid range: floor=%.1f >= ceil=%.1f", floor_db, ceil_db);
        return;
    }
    s.wf_db_floor = floor_db;
    s.wf_db_ceil = ceil_db;
    ESP_LOGI(TAG, "[sp] wf range: %.1f .. %.1f dB", floor_db, ceil_db);
}

void spectrum_clear(void)
{
    if (!s.canvas_buf)
    {
        return;
    }

    memset(s.canvas_buf, 0, (size_t)DISP_W * DISP_H * sizeof(uint16_t));

    /* Clear waterfall ring buffer too */
    if (s.wf_db)
    {
        /* Fill with floor dB so waterfall shows darkest colour */
        for (int i = 0; i < WF_H * DISP_W; i++)
            s.wf_db[i] = s.wf_db_floor;
        s.wf_write_idx = 0;
    }

    if (s.canvas && lvgl_port_lock(0))
    {
        lv_obj_invalidate(s.canvas);
        lvgl_port_unlock();
    }
}



esp_err_t spectrum_init(lv_obj_t *canvas, const spectrum_cfg_t *cfg)
{
    memset(&s, 0, sizeof(s));
    s.canvas = canvas;
    s.cfg = *cfg;

    /* Defaults for stream params — overwritten by spectrum_set_stream_params */
    s.channels = 2;
    s.bit_resolution = 24;
    s.bytes_per_sample = 3;  /* QMX uses 3-byte containers (bSubframeSize=3) */
    s.sample_freq = 48000;

    /* Default waterfall dB range (matches Python viewer defaults) */
    s.wf_db_floor = -140.0f;
    s.wf_db_ceil = 10.0f;
    s.view_mode = 0;

    /* Canvas pixel buffer: logical 284×76 RGB565 */
    const size_t buf_bytes = (size_t)DISP_W * DISP_H * sizeof(uint16_t);
    s.canvas_buf = heap_caps_malloc(buf_bytes, MALLOC_CAP_INTERNAL | MALLOC_CAP_8BIT);
    if (!s.canvas_buf)
    {
        ESP_LOGE(TAG, "canvas_buf alloc failed (%u bytes)", (unsigned)buf_bytes);
        return ESP_ERR_NO_MEM;
    }
    memset(s.canvas_buf, 0, buf_bytes);

    /* Attach to LVGL canvas */
    if (lvgl_port_lock(0))
    {
        lv_canvas_set_buffer(canvas, s.canvas_buf,
                             DISP_W, DISP_H,
                             LV_COLOR_FORMAT_RGB565);
        lvgl_port_unlock();
    }

    /* FFT buffer: fft_size complex floats */
    const size_t fft_bytes = (size_t)cfg->fft_size * 2 * sizeof(float);
    s.fft_buf = heap_caps_malloc(fft_bytes, MALLOC_CAP_INTERNAL | MALLOC_CAP_8BIT);
    if (!s.fft_buf)
    {
        ESP_LOGE(TAG, "fft_buf alloc failed");
        free(s.canvas_buf);
        return ESP_ERR_NO_MEM;
    }
    memset(s.fft_buf, 0, fft_bytes);

    /* Hann window */
    s.window = heap_caps_malloc((size_t)cfg->fft_size * sizeof(float),
                                MALLOC_CAP_INTERNAL | MALLOC_CAP_8BIT);
    if (!s.window)
    {
        ESP_LOGE(TAG, "window alloc failed");
        free(s.fft_buf);
        free(s.canvas_buf);
        return ESP_ERR_NO_MEM;
    }
    build_hann_window(s.window, (int)cfg->fft_size);

    /* Waterfall dB ring buffer: WF_H rows × DISP_W floats */
    const size_t wf_bytes = (size_t)WF_H * DISP_W * sizeof(float);
    s.wf_db = heap_caps_malloc(wf_bytes, MALLOC_CAP_INTERNAL | MALLOC_CAP_8BIT);
    if (!s.wf_db)
    {
        ESP_LOGE(TAG, "wf_db alloc failed (%u bytes)", (unsigned)wf_bytes);
        free(s.window);
        free(s.fft_buf);
        free(s.canvas_buf);
        return ESP_ERR_NO_MEM;
    }
    /* Initialize to floor so waterfall starts dark */
    for (int i = 0; i < WF_H * DISP_W; i++)
        s.wf_db[i] = s.wf_db_floor;
    s.wf_write_idx = 0;

    /* Initialise esp-dsp FFT tables */
    esp_err_t ret = dsps_fft2r_init_fc32(NULL, (int)cfg->fft_size);
    if (ret != ESP_OK)
    {
        ESP_LOGE(TAG, "dsps_fft2r_init_fc32 failed: %s", esp_err_to_name(ret));
        free(s.wf_db);
        free(s.window);
        free(s.fft_buf);
        free(s.canvas_buf);
        return ret;
    }
    s.dsp_initialized = true;

    /* Compute IF marker pixel position for initial view mode */
    if (cfg->if_freq_hz > 0 && s.sample_freq > 0)
    {
        float dc_bin = (float)(cfg->fft_size / 2);
        float if_bin = dc_bin + (float)cfg->if_freq_hz * (float)(cfg->fft_size) / (float)s.sample_freq;
        s.marker_px = (int)(if_bin * (float)(DISP_W - 1) / (float)(cfg->fft_size - 1) + 0.5f);
        if (s.marker_px < 0) s.marker_px = 0;
        if (s.marker_px >= DISP_W) s.marker_px = DISP_W - 1;
    }
    else
    {
        s.marker_px = -1;
    }

    BaseType_t ok = xTaskCreatePinnedToCore(spectrum_task, "spectrum",
                                            8192, NULL, 3,
                                            &s.task_handle, 1);
    if (ok != pdTRUE)
    {
        ESP_LOGE(TAG, "Failed to create spectrum task");
        free(s.wf_db);
        free(s.window);
        free(s.fft_buf);
        free(s.canvas_buf);
        return ESP_FAIL;
    }

    ESP_LOGI(TAG, "Spectrum init OK — FFT %u, %.1f fps, wf %dx%d (%.1f KB)",
             cfg->fft_size, cfg->lines_per_sec, DISP_W, WF_H,
             (float)wf_bytes / 1024.0f);
    return ESP_OK;
}

void spectrum_set_stream_params(uint8_t channels, uint8_t bit_resolution,
                                 uint32_t sample_freq)
{
    s.channels = channels;
    s.bit_resolution = bit_resolution;
    s.sample_freq = sample_freq;
    s.bytes_per_sample = (uint8_t)((bit_resolution + 7) / 8);
}

void spectrum_notify_rx(uac_host_device_handle_t handle)
{
    /* Called from the USB host client task (not an ISR), so use the
     * task-context notify API which does not need a yield hint. */
    s.uac_handle = handle;
    if (s.task_handle)
    {
        xTaskNotifyGive(s.task_handle);
    }
}

void spectrum_stop(void)
{
    s.uac_handle = NULL;
    if (s.task_handle)
    {
        vTaskDelete(s.task_handle);
        s.task_handle = NULL;
    }
    if (s.dsp_initialized)
    {
        dsps_fft2r_deinit_fc32();
    }
    free(s.window);
    free(s.fft_buf);
    free(s.wf_db);
    /* Detach canvas before freeing its backing buffer so the LVGL render
     * task never reads freed memory. */
    if (s.canvas_buf && s.canvas)
    {
        if (lvgl_port_lock(0))
        {
            lv_canvas_set_buffer(s.canvas, NULL, 0, 0, LV_COLOR_FORMAT_RGB565);
            lvgl_port_unlock();
        }
    }
    free(s.canvas_buf);
    memset(&s, 0, sizeof(s));
}
